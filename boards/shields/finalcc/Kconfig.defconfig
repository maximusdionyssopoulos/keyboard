## boards/shields/finalcc/Kconfig.defconfig
```kconfig
if SHIELD_finalcc_LEFT

config ZMK_KEYBOARD_NAME
    default "final-cc"

config ZMK_SPLIT_ROLE_CENTRAL
    default y

endif # SHIELD_finalcc_LEFT

if SHIELD_finalcc_LEFT || SHIELD_finalcc_RIGHT

config ZMK_SPLIT
    default y

config SPI
    default y

config ZMK_RGB_UNDERGLOW
    select WS2812_STRIP
    select SPI

endif # SHIELD_finalcc_LEFT || SHIELD_finalcc_RIGHT
```

## boards/shields/finalcc/Kconfig.shield
```kconfig
config SHIELD_finalcc_LEFT
    def_bool $(shields_list_contains,finalcc_left)

config SHIELD_finalcc_RIGHT
    def_bool $(shields_list_contains,finalcc_right)
```
